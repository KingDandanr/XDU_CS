WR_COM_AD_L	EQU	0264H			;写左半屏指令地址
WR_COM_AD_R	EQU	0260H			;写右半屏指令地址
WR_DATA_AD_L	EQU	0266H			;写左半屏数据地址
WR_DATA_AD_R	EQU	0262H			;写右半屏数据地址
RD_BUSY_AD	EQU	0261H			;查忙地址
RD_DATA_AD	EQU	0263H			;读数据地址

X		EQU	0B8H			;起始显示行基址
Y		EQU	040H			;起始显示列基址
FirstLine	EQU	0C0H			;起始显示行

_STACK		SEGMENT	STACK	
		DW	100 DUP(?)	
_STACK		ENDS		
			
_DATA		SEGMENT	WORD PUBLIC 'DATA'
;--  文字:  星  --
Line1_1	DB  000H,000H,0FCH,082H,082H,0AAH,02AH,0AAH,0AAH,0AAH,02AH,002H,002H,0FCH,000H,000H
	DB  000H,0EEH,09BH,090H,098H,094H,095H,080H,080H,080H,095H,095H,095H,095H,0FFH,000H

;--  文字:  研  --
Line1_2	DB  09EH,062H,002H,002H,002H,032H,0FEH,062H,002H,002H,032H,002H,002H,002H,062H,0DCH
	DB  003H,03CH,040H,040H,046H,040H,0F1H,08EH,080H,040H,07CH,080H,080H,080H,0FEH,003H

;--  文字:  电  --
Line1_3	DB  000H,0F8H,004H,004H,044H,044H,006H,002H,002H,046H,044H,004H,004H,0F8H,000H,000H
	DB  000H,00FH,010H,010H,011H,011H,0F0H,080H,090H,091H,091H,08CH,084H,087H,0C8H,078H

;--  文字:  子  --
Line1_4	DB  080H,040H,05EH,052H,052H,052H,032H,072H,082H,082H,042H,062H,052H,04CH,0C0H,000H
	DB  007H,004H,004H,004H,0FCH,08CH,08CH,080H,080H,07CH,004H,004H,004H,004H,007H,000H

;"STAR ES51PRO"
Line2_1	DB  000H,070H,088H,008H,008H,008H,038H,000H,000H,038H,020H,021H,021H,022H,01CH,000H

Line2_2	DB  018H,008H,008H,0F8H,008H,008H,018H,000H,000H,000H,020H,03FH,020H,000H,000H,000H

Line2_3	DB  000H,000H,0C0H,038H,0E0H,000H,000H,000H,020H,03CH,023H,002H,002H,027H,038H,020H

Line2_4	DB  008H,0F8H,088H,088H,088H,088H,070H,000H,020H,03FH,020H,000H,003H,00CH,030H,020H

Line2_5	DB  000H,000H,000H,000H,000H,000H,000H,000H,000H,000H,000H,000H,000H,000H,000H,000H

Line2_6	DB  008H,0F8H,088H,088H,0E8H,008H,010H,000H,020H,03FH,020H,020H,023H,020H,018H,000H

Line2_7	DB  000H,070H,088H,008H,008H,008H,038H,000H,000H,038H,020H,021H,021H,022H,01CH,000H

Line2_8	DB  000H,0F8H,008H,088H,088H,008H,008H,000H,000H,019H,021H,020H,020H,011H,00EH,000H

Line2_9	DB  000H,010H,010H,0F8H,000H,000H,000H,000H,000H,020H,020H,03FH,020H,020H,000H,000H

Line2_10 DB  008H,0F8H,008H,008H,008H,008H,0F0H,000H,020H,03FH,021H,001H,001H,001H,000H,000H

Line2_11 DB  008H,0F8H,088H,088H,088H,088H,070H,000H,020H,03FH,020H,000H,003H,00CH,030H,020H

Line2_12 DB  0E0H,010H,008H,008H,008H,010H,0E0H,000H,00FH,010H,020H,020H,020H,010H,00FH,000H

;--  文字:  欢  --
Line3_1	DB  014H,024H,044H,084H,064H,01CH,020H,018H,00FH,0E8H,008H,008H,028H,018H,008H,000H
	DB  020H,010H,04CH,043H,043H,02CH,020H,010H,00CH,003H,006H,018H,030H,060H,020H,000H

;--  文字:  迎  --
Line3_2	DB  040H,041H,0CEH,004H,000H,0FCH,004H,002H,002H,0FCH,004H,004H,004H,0FCH,000H,000H
	DB  040H,020H,01FH,020H,040H,047H,042H,041H,040H,05FH,040H,042H,044H,043H,040H,000H

;--  文字:  使  --
Line3_3	DB  040H,020H,0F0H,01CH,007H,0F2H,094H,094H,094H,0FFH,094H,094H,094H,0F4H,004H,000H
	DB  000H,000H,07FH,000H,040H,041H,022H,014H,00CH,013H,010H,030H,020H,061H,020H,000H

;--  文字:  用  --
Line3_4	DB  000H,000H,000H,0FEH,022H,022H,022H,022H,0FEH,022H,022H,022H,022H,0FEH,000H,000H
	DB  080H,040H,030H,00FH,002H,002H,002H,002H,0FFH,002H,002H,042H,082H,07FH,000H,000H
		
_DATA		ENDS		
			
CODE		SEGMENT		
START		PROC	NEAR	
		ASSUME	CS:CODE, DS:_DATA, SS:_STACK
		MOV	AX,_DATA	
		MOV	DS,AX
		NOP
START1:		CALL	LCD_INIT		;液晶初始化
		CALL	DelayTime
		CALL	DisLine1		;第2行显示"星研电子"
		CALL	DelayTime
		CALL	DisLine2		;第3行显示"STAR ES51PRO"
		CALL	DelayTime
		CALL	DisLine3		;第4行显示"欢迎使用"		
		CALL	DelayTime
		JMP	START1
;延时程序
DelayTime	PROC	NEAR
		MOV	CX,0
		LOOP	$
		LOOP	$
		RET
DelayTime	ENDP
;第2行显示"星研电子"
DisLine1	PROC	NEAR
		LEA	SI,Line1_1
		MOV	AL,2			;A-起始显示行地址，第2行
		MOV	AH,32			;B-起始显示列地址，第32列，以下同
		CALL	WordDISL		;左半屏，显示一个字子程序
		LEA	SI,Line1_2
		MOV	AL,2
		MOV	AH,48
		CALL	WordDISL
		LEA	SI,Line1_3
		MOV	AL,2
		MOV	AH,0
		CALL	WordDISR		;右半屏，显示一个字子程序
		LEA	SI,Line1_4
		MOV	AL,2
		MOV	AH,16
		CALL	WordDISR
		RET
DisLine1	ENDP		

;第3行显示"STAR ES51PRO"
DisLine2	PROC	NEAR
		LEA	SI,Line2_1
		MOV	AL,4			;A-起始显示行地址，第4行
		MOV	AH,16			;B-起始显示列地址，第16列，以下同
		CALL	ByteDISL		;左半屏，显示一个字节子程序
		LEA	SI,Line2_2
		MOV	AL,4
		MOV	AH,24		
		CALL	ByteDISL
		LEA	SI,Line2_3
		MOV	AL,4
		MOV	AH,32
		CALL	ByteDISL
		LEA	SI,Line2_4		
		MOV	AL,4
		MOV	AH,40
		CALL	ByteDISL
		LEA	SI,Line2_5
		MOV	AL,4
		MOV	AH,48
		CALL	ByteDISL
		LEA	SI,Line2_6		
		MOV	AL,4
		MOV	AH,56
		CALL	ByteDISL		
		LEA	SI,Line2_7
		MOV	AL,4
		MOV	AH,0
		CALL	ByteDISR		;右半屏字节显示数据
		LEA	SI,Line2_8
		MOV	AL,4
		MOV	AH,8
		CALL	ByteDISR
		LEA	SI,Line2_9
		MOV	AL,4
		MOV	AH,16		
		CALL	ByteDISR
		LEA	SI,Line2_10
		MOV	AL,4
		MOV	AH,24
		CALL	ByteDISR
		LEA	SI,Line2_11
		MOV	AL,4
		MOV	AH,32
		CALL	ByteDISR		
		LEA	SI,Line2_12
		MOV	AL,4
		MOV	AH,40
		CALL	ByteDISR
		RET
DisLine2	ENDP		

;第4行显示"欢迎使用"
DisLine3	PROC	NEAR
		LEA	SI,Line3_1		
		MOV	AL,6			;A-起始显示行地址，第6行
		MOV	AH,32			;B-起始显示列地址，第32列，以下同
		CALL	WordDISL		;左半屏，显示一个字子程序
		LEA	SI,Line3_2
		MOV	AL,6
		MOV	AH,48
		CALL	WordDISL
		LEA	SI,Line3_3
		MOV	AL,6
		MOV	AH,0
		CALL	WordDISR		;右半屏，显示一个字子程序
		LEA	SI,Line3_4
		MOV	AL,6
		MOV	AH,16
		CALL	WordDISR
		RET
DisLine3	ENDP		

;液晶初始化	
LCD_INIT	PROC	NEAR
		MOV	AL,3EH	 		;初始化左半屏，关显示
		CALL	WRComL			;写指令子程序
		MOV	AL,FirstLine		;设置起始显示行，第0行
		CALL	WRComL
		MOV	AL,3EH	 		;初始化右半屏，关显示
		CALL	WRComR			;写指令子程序
		MOV	AL,FirstLine		;设置起始显示行，第0行
		CALL	WRComR
		CALL	LCDClear		;清屏
		MOV	AL,3FH			;开显示
		CALL	WRComL
		MOV	AL,3FH			;开显示
		CALL	WRComR
		RET
LCD_INIT	ENDP
;清屏
LCDClear	PROC	NEAR
;清左半屏
		MOV	AL,0			;起始行，第0行
		MOV	AH,0			;起始列，第0列
LCDClearL1:	PUSH	AX
		MOV	CX,64
		CALL	SETXYL			;设置起始显示行列地址
LCDClearL2:	MOV	AL,0
		CALL	WRDATAL
		LOOP	LCDClearL2
		POP	AX
		INC	AX
		CMP	AL,8			;共8行
		JNZ	LCDClearL1	
		;清右半屏
		MOV	AL,0			;起始行，第0行
		MOV	AH,0			;起始列，第0列
LCDClearR1:	PUSH	AX
		MOV	CX,64
		CALL	SETXYR			;设置起始显示行列地址
LCDClearR2:	XOR	AL,AL
		CALL	WRDATAR
		LOOP	LCDClearR2		
		POP	AX
		INC	AL
		CMP	AL,8			;共8行
		JNZ	LCDClearR1
		RET
LCDClear	ENDP

;***************************************
;显示字体，显示一个数据要占用X行两行位置
;***************************************
;左半屏显示一个字节/字：AL-起始显示行序数X(0-7)；AH-起始显示列序数Y(0-63)；SI-显示字数据首地址
ByteDisL	PROC	NEAR
		MOV	CX,8			;显示8个字节数据，用于显示一个英文/符号
		CALL	DispL
		RET
ByteDisL	ENDP
		
WordDisL	PROC	NEAR
		MOV	CX,16			;显示16字节数据，用于显示一个汉字
		CALL	DispL
		RET
WordDisL	ENDP

DispL		PROC	NEAR
		PUSH	AX
		PUSH	CX
		CALL	SETXYL			;设置起始显示行列地址
		CALL	DisplayL		;显示上半行数据
		POP	CX
		POP	AX
		INC	AL
		CALL	SETXYL			;设置起始显示行列地址
		CALL	DisplayL		;显示下半行数据
		RET	
DispL		ENDP

;右半屏显示一个字节/字：AL-起始显示行序数X(0-7)；AH-起始显示列序数Y(0-63)；SI-显示字数据首地址
ByteDisR	PROC	ENAR
		MOV	CX,8			;显示8个字节数据，用于显示一个英文/符号
		CALL	DispR
		RET
ByteDisR	ENDP
		
WordDisR	PROC	NEAR
		MOV	CX,16			;显示16字节数据，用于显示一个汉字
		CALL	DispR
		RET
WordDisR	ENDP
		
DispR		PROC	NEAR
		PUSH	AX
		PUSH	CX
		CALL	SETXYR			;设置起始显示行列地址
		CALL	DisplayR		;显示上半行数据
		POP	CX
		POP	AX
		INC	AL
		CALL	SETXYR			;设置起始显示行列地址
		CALL	DisplayR		;显示下半行数据
		RET	
DispR		ENDP

;***************************************
;显示图形		
;***************************************
;显示左半屏一行图形,AL-X起始行序数(0-7)，AH-Y起始列地址序数(0-63)
LineDisL	PROC	NEAR
		MOV	CX,64		
		CALL	SETXYL			;设置起始显示行列
		CALL	DisplayL		;显示数据
		RET
LineDisL	ENDP		
;显示右半屏一行图形,AL-X起始行地址序数(0-7)，AH-Y起始列地址序数(0-63)
LineDisR	PROC	NEAR
		MOV	CX,64
		CALL	SETXYR			;设置起始显示行列
		CALL	DisplayR		;显示数据
		RET		
LineDisR	ENDP

;***************************************
;基本控制		
;***************************************
;显示左半屏数据，R7-显示数据个数
DisplayL	PROC	NEAR
		LODSB
		CALL	WRDataL			;写左半屏数据
		LOOP	DisplayL
		RET
DisplayL	ENDP

;显示右半屏数据，R7-显示数据个数
DisplayR	PROC	NEAR
		LODSB
		CALL	WRDataR			;写左半屏数据
		LOOP	DisplayR
		RET
DisplayR	ENDP

;设置左半屏起始显示行列地址,AL-X起始行序数(0-7)，AH-Y起始列序数(0-63)
SETXYL		PROC	NEAR
		OR	AL,X			;行地址=行序数+行基址
		CALL	WRComL
		MOV	AL,AH
		OR	AL,Y			;列地址=列序数+列基址
		CALL	WRComL
		RET
SETXYL		ENDP

;设置右半屏起始显示行列地址,AL-X起始行序数(0-7)，AH-Y起始列序数(0-63)
SETXYR		PROC	NEAR
		OR	AL,X			;行地址=行序数+行基址
		CALL	WRComR
		MOV	AL,AH
		OR	AL,Y			;列地址=列序数+列基址
		CALL	WRComR
		RET
SETXYR		ENDP

;写左半屏控制指令，A-写入指令
WRComL		PROC	NEAR
		MOV	DX,WR_COM_AD_L	
		OUT	DX,AL
WRComL1:	MOV	DX,RD_BUSY_AD
		IN	AL,DX
		TEST	AL,80H			;检查液晶显示是否处于忙状态
		JNZ	WRComL1
		RET
WRComL		ENDP


;写右半屏控制指令，A-写入指令
WRComR		PROC	NEAR
		MOV	DX,WR_COM_AD_R
		OUT	DX,AL
WRComR1:	MOV	DX,RD_BUSY_AD
		IN	AL,DX
		TEST	AL,80H			;检查液晶显示是否处于忙状态
		JNZ	WRComR1
		RET	
WRComR		ENDP

;写左半屏数据，A-写入数据	
WRDataL		PROC	NEAR
		MOV	DX,WR_DATA_AD_L
		OUT	DX,AL
WRDataL1:	MOV	DX,RD_BUSY_AD
		IN	AL,DX
		TEST	AL,80H			;检查液晶显示是否处于忙状态
		JNZ	WRDataL1
		RET	
WRDataL		ENDP


;写右半屏数据，A-写入数据	
WRDataR		PROC	NEAR
		MOV	DX,WR_DATA_AD_R
		OUT	DX,AL
WRDataR1:	MOV	DX,RD_BUSY_AD
		IN	AL,DX
		TEST	AL,80H			;检查液晶显示是否处于忙状态
		JNZ	WRDataR1
		RET
WRDataR		ENDP
		
START		ENDP		
CODE		ENDS		
		END	START
